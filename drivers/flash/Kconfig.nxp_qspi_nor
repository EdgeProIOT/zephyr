## drivers/flash/Kconfig.nxp_qspi_nor
```kconfig
# Copyright (c) 2020 Softube AB
# SPDX-License-Identifier: Apache-2.0

menuconfig NXP_QSPI_NOR
		bool "NXP QSPI NOR Flash"
		select FLASH_HAS_DRIVER_ENABLED
		select FLASH_HAS_PAGE_LAYOUT
		help
			Enable support for NXP QSPI NOR Flash driver using FlexSPI.

if NXP_QSPI_NOR

config NXP_QSPI_NOR_INIT_PRIORITY
	int
	default 80
	help
	  Device driver initialization priority.

endif # NXP_QSPI_NOR 
```

## modules/Kconfig.luajit
```kconfig
# Luajit Zephyr

# Copyright (c) 2020 Jernej Turnsek
# SPDX-License-Identifier: Apache-2.0

config LUAJIT
	bool "LuaJIT Support"
	help
	  This option enables the LuaJIT library.
```
